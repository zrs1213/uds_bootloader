VERSION ""

NS_ :

BS_:

BU_: ECU DiagnosticTool

BO_ 2016 DiagRequest: 8 ECU
 SG_ Data: 1|64@1+ (1,0) [0|0] "" DiagnosticTool

BO_ 2024 DiagResponse: 8 DiagnosticTool
 SG_ Data: 1|64@1+ (1,0) [0|0] "" ECU
